## conf/layer.conf
```bitbake
# We have a conf and classes directory, append to BBPATH
BBPATH .= ":${LAYERDIR}"

# We have a recipes directory, add to BBFILES
BBFILES += "${LAYERDIR}/recipes*/*/*.bb ${LAYERDIR}/recipes*/*/*.bbappend"

BBFILE_COLLECTIONS += "meta-nerves"
BBFILE_PATTERN_meta-nerves := "^${LAYERDIR}/"
# increase the number 
BBFILE_PRIORITY_meta-nerves= "9"

NERVES_SYSTEM_PATH = '${@os.path.normpath("${LAYERDIR}/nerves_system")}'

LAYERSERIES_COMPAT_meta-nerves-layer = "sumo warrior dunfell"

# yves
BBDEBUG = "yes"
```
